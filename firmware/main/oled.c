#include <string.h>
#include "driver/i2c_master.h"
#include "oled.h"

#define OLED_I2C_PORT I2C_NUM_0     // the BNO055 has I2C_NUM_1 on its own pins
#define I2C_TIMEOUT_MS 50

static i2c_master_bus_handle_t s_bus;
static i2c_master_dev_handle_t s_dev;
// Byte 0 is the I2C "data" control byte, so the whole frame goes out in one transfer.
static uint8_t s_frame[1 + OLED_W * OLED_H / 8];
static uint8_t *const s_fb = &s_frame[1];

// Classic 5x7 font, ASCII 0x20..0x7E, column-major, LSB = top pixel (SSD1306 page layout).
static const uint8_t FONT5X7[][5] = {
    {0x00,0x00,0x00,0x00,0x00},{0x00,0x00,0x5F,0x00,0x00},{0x00,0x07,0x00,0x07,0x00},{0x14,0x7F,0x14,0x7F,0x14},
    {0x24,0x2A,0x7F,0x2A,0x12},{0x23,0x13,0x08,0x64,0x62},{0x36,0x49,0x55,0x22,0x50},{0x00,0x05,0x03,0x00,0x00},
    {0x00,0x1C,0x22,0x41,0x00},{0x00,0x41,0x22,0x1C,0x00},{0x08,0x2A,0x1C,0x2A,0x08},{0x08,0x08,0x3E,0x08,0x08},
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    {0x00,0x00,0x7F,0x00,0x00},{0x00,0x41,0x36,0x08,0x00},{0x08,0x08,0x2A,0x1C,0x08},
};

static bool send_cmds(const uint8_t *cmds, size_t n)
{
    uint8_t buf[32];
    buf[0] = 0x00;   // control byte: command stream
    memcpy(&buf[1], cmds, n);
    return i2c_master_transmit(s_dev, buf, n + 1, I2C_TIMEOUT_MS) == ESP_OK;
}

static const uint8_t INIT[] = {
    0xAE,             // display off
    0xD5, 0x80,       // clock divide
    0xA8, 0x3F,       // multiplex 64
    0xD3, 0x00,       // display offset
    0x40,             // start line 0
    0x8D, 0x14,       // charge pump on
    0x20, 0x00,       // horizontal addressing
    0xA1,             // segment remap (column 127 = SEG0)
    0xC8,             // COM scan descending
    0xDA, 0x12,       // COM pins for 128x64
    0x81, 0xCF,       // contrast
    0xD9, 0xF1,       // pre-charge
    0xDB, 0x40,       // VCOMH
    0xA4,             // display follows RAM
    0xA6,             // normal (not inverted)
    0x2E,             // no scrolling
    0xAF,             // display on
};

bool oled_init(int sda_gpio, int scl_gpio, uint8_t addr)
{
    const i2c_master_bus_config_t bus = {
        .i2c_port = OLED_I2C_PORT,
        .sda_io_num = sda_gpio,
        .scl_io_num = scl_gpio,
        .clk_source = I2C_CLK_SRC_DEFAULT,
        .glitch_ignore_cnt = 7,
        .flags.enable_internal_pullup = true,   // modules usually have pull-ups too
    };
    if (i2c_new_master_bus(&bus, &s_bus) != ESP_OK) return false;
    const i2c_device_config_t dev = {
        .dev_addr_length = I2C_ADDR_BIT_LEN_7,
        .device_address = addr,
        .scl_speed_hz = 400000,
    };
    if (i2c_master_bus_add_device(s_bus, &dev, &s_dev) != ESP_OK) {
        i2c_del_master_bus(s_bus);
        return false;
    }

    if (!send_cmds(INIT, sizeof(INIT))) {
        i2c_master_bus_rm_device(s_dev);
        i2c_del_master_bus(s_bus);
        return false;
    }
    s_frame[0] = 0x40;   // control byte: data stream
    oled_clear();
    return oled_flush();
}

bool oled_refresh_config(void)
{
    // Skip the leading "display off" so a healthy panel does not flicker.
    if (send_cmds(&INIT[1], sizeof(INIT) - 1)) return true;
    i2c_master_bus_reset(s_bus);   // clocks out a slave left holding SDA low
    return false;
}

void oled_clear(void) { memset(s_fb, 0, OLED_W * OLED_H / 8); }

void oled_text(int col, int row, const char *s)
{
    if (row < 0 || row >= OLED_ROWS) return;
    for (; *s && col < OLED_COLS; s++, col++) {
        char c = *s;
        if (c < 0x20 || c > 0x7E) c = '?';
        uint8_t *dst = &s_fb[row * OLED_W + col * 6];
        memcpy(dst, FONT5X7[c - 0x20], 5);
        dst[5] = 0;
    }
}

void oled_bar(int row, float frac, float marker)
{
    if (row < 0 || row >= OLED_ROWS) return;
    if (frac < 0) frac = 0;
    if (frac > 1) frac = 1;
    uint8_t *page = &s_fb[row * OLED_W];
    const int fill = (int)(frac * (OLED_W - 2));
    page[0] = page[OLED_W - 1] = 0x7E;                 // end caps
    for (int x = 1; x < OLED_W - 1; x++) {
        page[x] = (x - 1 < fill) ? 0x7E : 0x42;        // filled vs outline
    }
    if (marker >= 0 && marker <= 1) {
        page[1 + (int)(marker * (OLED_W - 3))] = 0xFF; // full-height tick
    }
}

bool oled_flush(void)
{
    static const uint8_t window[] = {0x21, 0x00, 0x7F, 0x22, 0x00, 0x07};   // all columns, all pages
    if (!send_cmds(window, sizeof(window))) return false;
    return i2c_master_transmit(s_dev, s_frame, sizeof(s_frame), I2C_TIMEOUT_MS) == ESP_OK;
}
